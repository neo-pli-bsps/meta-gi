## conf/machine/et1x000.conf
```bitbake
#@TYPE: Machine
#@NAME: Galaxy Innovations ET11000
#@DESCRIPTION: Machine configuration for the Galaxy Innovations ET11000

MACHINE_FEATURES += " textlcd 7segment dvb-c nextv-blindscan-dvbc mmc v3d-nxclient"
OPENPLI_FEATURES += " ci"
DISTRO_FEATURES_remove = "x11 wayland directfb"

CHIPSET = "bcm7251s"

PREFERRED_VERSION_linux-nextv = "4.1.37"
require conf/machine/include/nextv-arm.inc

SOC_FAMILY = "bcm7251s"

RCTYPE = "504"
RCNAME = "et7x00mini"
```

## conf/machine/et7x00.conf
```bitbake
#@TYPE: Machine
#@NAME: Galaxy Innovations et-7x00 Mini
#@DESCRIPTION: Machine configuration for the Galaxy Innovations et-7x00 Mini

CHIPSET = "bcm7362"

MACHINE_FEATURES += "textlcd dvb-c blindscan-dvbc"
MACHINE_KERNEL_PR = "r0"

require conf/machine/include/et7k.inc
```
